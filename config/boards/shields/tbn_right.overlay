#include "encoder_right.overlay"
#include "joystick_right.overlay"


/ {
    chosen {
        zmk,kscan = &kscan0;
    };

    kscan0: kscan {
        compatible = "zmk,kscan-gpio-matrix";
        wakeup-source;
        diode-direction = "row2col";

        row-gpios = <&gpio1 15 (GPIO_ACTIVE_HIGH | GPIO_PULL_DOWN)>,
                    <&gpio1 7  (GPIO_ACTIVE_HIGH | GPIO_PULL_DOWN)>,
                    <&gpio1 2  (GPIO_ACTIVE_HIGH | GPIO_PULL_DOWN)>,
                    <&gpio1 1  (GPIO_ACTIVE_HIGH | GPIO_PULL_DOWN)>;

        col-gpios = <&gpio0 6  GPIO_ACTIVE_HIGH>,
                    <&gpio0 24 GPIO_ACTIVE_HIGH>,
                    <&gpio1 0  GPIO_ACTIVE_HIGH>,
                    <&gpio1 4  GPIO_ACTIVE_HIGH>,
                    <&gpio0 15 GPIO_ACTIVE_HIGH>,
                    <&gpio0 14 GPIO_ACTIVE_HIGH>,
                    <&gpio0 10 GPIO_ACTIVE_HIGH>,
                    <&gpio1 11 GPIO_ACTIVE_HIGH>,
                    <&gpio1 13 GPIO_ACTIVE_HIGH>;
    };
};
