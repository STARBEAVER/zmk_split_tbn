&spi0 {
    status = "okay";

    sck-pin = <22>;        // P0.22 (SCK)
    mosi-pin = <11>;       // P0.11 (MOSI)
        
    cs-gpios = <&gpio0 17 GPIO_ACTIVE_LOW>; // Chip Select
    st7789: st7789@0 {
        compatible = "sitronix,st7789";
        reg = <0>;
        spi-max-frequency = <20000000>;

        width = <240>;
        height = <240>;

        reset-gpios = <&gpio0 20 GPIO_ACTIVE_LOW>;
        cmd-data-gpios = <&gpio0 17 GPIO_ACTIVE_HIGH>; // DC (иногда называют RS)
    };
};
